## arch/arm/Kconfig.htc
```kconfig
comment "HTC Debugging Features"
menuconfig HTC_DEBUG
	bool "HTC Debugging Feature Switch"
	default y
	help
	  Enable collection of debug features.
	  This feature is enabled in defconfig.

config HTC_BUILD_EDIAG
        bool "Build in embedded diag NVRAM support"
        default n
        help
          For embedded diag we need to support NVRAM.

config HTC_DEBUG_SSR
	bool "HTC style subsys restart debug features"
	depends on HTC_DEBUG && MSM_SUBSYSTEM_RESTART
	help
	  Say Y here if you want the HTC style subsys restart debug features

config HTC_DEBUG_SSR_MODEM
	bool "HTC style modem subsys restart debug features"
	depends on HTC_DEBUG && MSM_SUBSYSTEM_RESTART && HTC_DEBUG_SSR
	help
	  Say Y here if you want the HTC style modem subsys restart debug features

config HTC_DEBUG_AUDIO
	bool "Flag for HTC audio error trigger ramdump or debugging log"
	depends on HTC_DEBUG
	help
	  Say Y here if you want the HTC audio debug enable

config HTC_POWER_DEBUG
	bool "Support htc power debug feature"
	help
	  Use this to enable htc power debug feature including pm statistics,
	  clock/gpio/qpnp pin dump, wakeup source, kerenl top and autosuspend
	  stage footprint

config HTC_DEBUG_RTB
	default y
	depends on HTC_DEBUG && MSM_RTB
	bool "HTC style rtb debug features"
	help
	  Say Y here if you want the HTC style rtb debug features

comment "HTC features"
menuconfig HTC_FEATURES
	bool "HTC Implement Features"
	default n
	help
	  Enable collection of HTC features.
	  This feature is enabled in defconfig.

config HTC_FEATURES_SSR
	bool "HTC style ssr features"
	depends on HTC_FEATURES && MSM_SUBSYSTEM_RESTART
	default n
	help
	  Say Y here if you want the HTC style ssr features

config HTC_FEATURES_SSR_MODEM
	bool "HTC style modem ssr features"
	depends on HTC_FEATURES && MSM_SUBSYSTEM_RESTART && HTC_FEATURES_SSR
	default n
	help
	  Say Y here if you want the HTC style ssr features

config HTC_FEATURES_SSR_MODEM_ENABLE
	bool "HTC style modem ssr enable features"
	depends on HTC_FEATURES_SSR_MODEM
	default n
	help
	  Say Y here if you want the HTC style for modem ssr features

config HTC_FEATURES_SSR_LPASS_ENABLE
       bool "HTC style lpass ssr features"
       depends on HTC_FEATURES_SSR
       default n
       help
         Say Y here if you want the HTC style for lpass ssr features

config HTC_FEATURES_SSR_WCNSS_ENABLE
       bool "HTC style lpass ssr features"
       depends on HTC_FEATURES_SSR
       default n
       help
         Say Y here if you want the HTC style for lpass ssr features

config LMK_ZYGOTE_PROTECT
       bool "LMK zygote protect"
       default n
       help
```

## drivers/i2c/chips/Kconfig
```kconfig
#
# Miscellaneous I2C chip drivers configuration
#
# *** DEPRECATED! Do not add new entries! See Makefile ***
#


config SENSORS_NFC_PN544
        tristate "PN544 NFC sensor support"
        depends on I2C=y
        help
          PN544 NFC Driver implemented.

config SENSORS_NFC_PN548
        tristate "PN548 NFC sensor support"
        depends on I2C=y
        help
          PN548 NFC Driver implemented.
```

## drivers/i2c/sensors/common/Kconfig
```kconfig
#
# IIO common modules
#

source "drivers/i2c/sensors/common/st_sensors/Kconfig"
```

## drivers/i2c/sensors/common/st_sensors/Kconfig
```kconfig
#
# STMicroelectronics sensors common library
#

config IIO_ST_SENSORS_I2C_HTC
	tristate

config IIO_ST_SENSORS_SPI_HTC
	tristate

config IIO_ST_SENSORS_CORE_HTC
	tristate
	select IIO_ST_SENSORS_I2C_HTC if I2C
	select IIO_ST_SENSORS_SPI_HTC if SPI_MASTER
```
