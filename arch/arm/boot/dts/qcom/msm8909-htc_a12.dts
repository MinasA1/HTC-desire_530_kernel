/* Copyright (c) 2014, The Linux Foundation. All rights reserved.
 *
 * This program is free software; you can redistribute it and/or modify
 * it under the terms of the GNU General Public License version 2 and
 * only version 2 as published by the Free Software Foundation.
 *
 * This program is distributed in the hope that it will be useful,
 * but WITHOUT ANY WARRANTY; without even the implied warranty of
 * MERCHANTABILITY or FITNESS FOR A PARTICULAR PURPOSE.  See the
 * GNU General Public License for more details.
 */

/dts-v1/;

#include "msm8909-htc_a12.dtsi"
#include "msm8909-pm8909.dtsi"
#include "msm8909-pm8909-htc_a12.dtsi"
#include "msm8909-camera-sensor-A13.dtsi"

/ {
	model = "HTC Corporation. MSM8909-PM8909 A12";
	compatible = "htc,msm8909-a12";

	qcom,msm-id = <394 0>;
	qcom,board-id = <0 0>;
};
